## meta-virtual/conf/layer.conf
```bitbake
# We have a conf and classes directory, add to BBPATH
BBPATH .= ":${LAYERDIR}"

# We have recipes-* directories, add to BBFILES
BBFILES += "${LAYERDIR}/recipes-*/*/*.bb \
            ${LAYERDIR}/recipes-*/*/*.bbappend"

BBFILE_COLLECTIONS += "meta-virtual"
BBFILE_PATTERN_meta-virtual = "^${LAYERDIR}/"
BBFILE_PRIORITY_meta-virtual = "6"

LAYERDEPENDS_meta-virtual = "core"
LAYERSERIES_COMPAT_meta-virtual = "dunfell"
```
